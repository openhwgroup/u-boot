## board/pulp-platform/occamy/Kconfig
```kconfig
if TARGET_PULP_PLATFORM_OCCAMY

config SYS_BOARD
	default "occamy"

config SYS_VENDOR
	default "pulp-platform"

config SYS_CPU
	default "generic"

config SYS_CONFIG_NAME
	default "pulp-platform_occamy"

config SYS_TEXT_BASE
	default 0x80200000 if SPL
	default 0x80000000 if !RISCV_SMODE
	default 0x80200000 if RISCV_SMODE

config SPL_TEXT_BASE
	default 0x70000000

config SPL_OPENSBI_LOAD_ADDR
	default 0x80000000

config BOARD_SPECIFIC_OPTIONS # dummy
	def_bool y
	select GENERIC_RISCV
	select SUPPORT_SPL

endif
```

## configs/pulp-platform_occamy_defconfig
```kconfig
CONFIG_RISCV=y
CONFIG_DEFAULT_DEVICE_TREE="occamy"
CONFIG_TARGET_PULP_PLATFORM_OCCAMY=y
CONFIG_ARCH_RV64I=y
CONFIG_LOG=y
CONFIG_LOG_MAX_LEVEL=9
CONFIG_LOGF_FUNC=y
CONFIG_LOG_ERROR_RETURN=y
CONFIG_FIT=y
CONFIG_SPL=y
CONFIG_SPL_LOAD_FIT=y
CONFIG_SYS_MALLOC_F_LEN=0x3000
CONFIG_SPL_MTD_SUPPORT=y
CONFIG_SPL_SPI_FLASH_MTD=y
CONFIG_SPL_SPI_FLASH_SUPPORT=y
CONFIG_SPL_SPI_SUPPORT=y
CONFIG_SPL_SPI_LOAD=y
CONFIG_SPL_DM=y
CONFIG_SPL_DM_SPI=y
CONFIG_SPL_DM_SPI_FLASH=y
CONFIG_SPL_LIBCOMMON_SUPPORT=y
CONFIG_OF_PRIOR_STAGE=y
CONFIG_CMD_MTDPARTS=y
CONFIG_MTDIDS_DEFAULT="nor0=spi0.0"
CONFIG_MTDPARTS_DEFAULT="mtdparts=spi0.0:96m(bitstream),1m(u-boot),16m(uimage),-(filesystem)"
CONFIG_SPI_FLASH_ATMEL=y
CONFIG_SPI_FLASH_EON=y
CONFIG_SPI_FLASH_GIGADEVICE=y
CONFIG_SPI_FLASH_ISSI=y
CONFIG_SPI_FLASH_MACRONIX=y
CONFIG_SPI_FLASH_SPANSION=y
CONFIG_SPI_FLASH_STMICRO=y
CONFIG_SPI_FLASH_SST=y
CONFIG_SPI_FLASH_WINBOND=y
CONFIG_SPI_FLASH_XMC=y
# CONFIG_SPI_FLASH_USE_4K_SECTORS is not set
CONFIG_MTD=y
CONFIG_DM_MTD=y
CONFIG_SPI_FLASH_MTD=y
CONFIG_SYS_NS16550=y
CONFIG_SPI=y
CONFIG_XILINX_SPI=y
CONFIG_RISCV_SMODE=y
CONFIG_OF_LIBFDT=y
CONFIG_OF_BOARD_SETUP=y
CONFIG_BOOTDELAY=5
CONFIG_USE_BOOTCOMMAND=y
CONFIG_BOOTCOMMAND="sf probe; sf read 82000000 6100000 b00000; bootm 82000000 - $(fdtcontroladdr);"
CONFIG_DISPLAY_CPUINFO=y
```
